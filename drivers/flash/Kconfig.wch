## drivers/flash/Kconfig.wch
```kconfig
# WCH MCUs Flash driver config

config SOC_FLASH_WCH
    bool "WCH flash driver"
    default y
    depends on DT_HAS_WCH_CH5XX_FLASH_CONTROLLER_ENABLED
    select FLASH_HAS_DRIVER_ENABLED
    select FLASH_HAS_PAGE_LAYOUT
	select FLASH_HAS_EXPLICIT_ERASE
    help
      Enable flash driver for WCH CH5xx series
```

## drivers/pwm/Kconfig.wch
```kconfig
# CH5XX PWM config options

config PWM_CH5XX
    bool "WCH ch5xx series PWM driver"
    default y
    depends on DT_HAS_WCH_CH5XX_PWM_ENABLED
    help 
      This option enables the PWM driver for WCH ch5xx series MCUs
```

## drivers/usb/udc/Kconfig.ch58x
```kconfig
# Copyright (c) 2023 Nordic Semiconductor ASA
# SPDX-License-Identifier: Apache-2.0

config UDC_CH58X
	bool "WCH ch58x USB device controller driver"
	default y
	depends on DT_HAS_WCH_CH58X_UDC_ENABLED
	imply UDC_WORKQUEUE
	help
	  WCH ch58x USB device controller driver.

config UDC_CH58X_MAX_EP_MSG
	int "Maximum number of UDC events"
	depends on UDC_CH58X
	range 4 64
	default 10
	help
	  Maximum number of USB device controller internal endpoint
	  events that can be queued.
```

## dts/bindings/flash_controller/wch,ch5xx-flash-controller.yaml
```yaml
description: WCH CH5xx Family flash controller

compatible: "wch,ch5xx-flash-controller"

include: flash-controller.yaml
```

## dts/bindings/mtd/wch,nv-flash.yaml
```yaml
description: |
  WCH flash memory node. This binding is for the flash 
  memory itself, not the flash controller peripheral.


include: soc-nv-flash.yaml

compatible: wch,nv-flash

properties:
  reg:
    required: true
    description: array specifying flash areas

  reg-names:
    required: true
    description: |
      Names corresponding to the entries in the 'reg' property.
      "code_flash" specifies reg entry for Code Flash area,
      "data_flash" specifies reg entry for Data Flash area,

  erase-block-size:
    required: true
    description: address alignment required by code flash erase operations

  write-block-size:
    required: true
    description: address alignment required by code flash write operations

  data-erase-block-size:
    type: int
    required: true
    description: address alignment required by data flash erase operations

  data-write-block-size:
    type: int
    required: true
    description: address alignment required by data flash write operations
```

## dts/bindings/pwm/wch,ch5xx-pwm.yaml
```yaml
#davit

description: WCH CH5xx PWM driver

compatible: "wch,ch5xx-pwm"

include: [pwm-controller.yaml, base.yaml, pinctrl-device.yaml]

properties:
    pinctrl-0:
      required: true

    pinctrl-names:
      required: true

    clocks:
      required: true

    prescaler:
      type: int
      required: true
      description: PWM divider,the range of the divider can be from 0 to 255 

    period:
      type: int
      required: true
      description: PWM period in clock cycles. ch5xx series accept only |
                  8 fixed values. This setting is common for all channels
      enum:
        - 31
        - 32
        - 63
        - 64
        - 127
        - 128
        - 255
        - 256

    "#pwm-cells":
      const: 3

pwm-cells:
- channel
- period
- flags
```

## dts/bindings/usb/wch,ch58x-udc.yaml
```yaml
# Copyright (c) 2018, Sundar Subramaniyan <sundar.subramaniyan@gmail.com>
# SPDX-License-Identifier: Apache-2.0

description: |
    WCH CH58x USB device controller

compatible: "wch,ch58x-udc"

include: usb-ep.yaml

properties:
  reg:
    required: true

  interrupts:
    required: true
```
