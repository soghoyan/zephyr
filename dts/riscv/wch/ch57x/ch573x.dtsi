/*
 * Copyright (c) 2023-2024 Chen Xingyu <hi@xingrz.me>
 * SPDX-License-Identifier: Apache-2.0
 */

#include <wch/ch57x/ch57x-common.dtsi>
#include <wch/ch57x/ch573-common.dtsi>
#include <wch/ch57x/ch573(xq)-common.dtsi>

/ {
	soc {
		compatible = "wch,ch573x";

		flash-controller@40001800 {
			flash0: flash@0 {
				reg = <0x00000000 DT_SIZE_K(448)>,
				      <0x00070000 DT_SIZE_K(32)>;
			};
		};
	};
};
